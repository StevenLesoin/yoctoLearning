## meta-test/conf/distro/testdistro.conf
```bitbake
# Distro Layer configuration
# include and overwrite default poky distro
include conf/distro/poky.conf
DISTRO = "testdistro"
DISTRO_NAME = "TestDistro-Linux"
DISTRO_VERSION = "0.1"
DISTRO_CODENAME = "kamoulox"
SDK_VENDOR = "-testdistrosdk"
SDK_VERSION="${DISTRO_VERSION}"
MAINTAINER = "Steven Lesoin"

TARGET_VENDOR = "-testdistro"

# Override these in poky based distros
TESTDISTRO_DEFAULT_DISTRO_FEATURES = ""
TESTDISTRO_DEFAULT_EXTRA_RDEPENDS = "packagegroup-core-boot"
TESTDISTRO_DEFAULT_EXTRA_RRECOMMENDS = "kernel-module-af-packet"

DISTRO_EXTRA_RDEPENDS += " ${TESTDISTRO_DEFAULT_EXTRA_RDEPENDS}"
DISTRO_EXTRA_RRECOMMENDS += " ${TESTDISTRO_DEFAULT_EXTRA_RRECOMMENDS}"

DISTRO_FEATURES ?= "${TESTDISTRO_DEFAULT_DISTRO_FEATURES} ${DISTRO_FEATURES_LIBC} "

PACKAGE_CLASSES = "package_deb"

# Use systemd as init manager
DISTRO_FEATURES_append = " systemd"
DISTRO_FEATURES_BACKFILL_CONSIDERED += "sysvinit"
VIRTUAL-RUNTIME_init_manager = "systemd"
VIRTUAL-RUNTIME_initscripts = "systemd-compat-units"
```
